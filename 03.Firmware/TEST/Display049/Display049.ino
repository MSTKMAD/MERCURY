#include <SPI.h>
#include <Wire.h>
#include <Adafruit_GFX.h>
#include <Adafruit_SSD1306_049.h>
// SCL GPIO5
// SDA GPIO4

#define X_SIZE 64
#define Y_SiZE 32
#define MAX_LEDS X_SIZE / 4
#define OLED_RESET 0 // GPIO0
Adafruit_SSD1306 display(OLED_RESET);
const static unsigned char __attribute__((progmem)) MusotokuLogo[] = {
    0x03, 0xff, 0xff, 0xff, 0xff, 0xff, 0xff, 0xff, 0x00,
    0x06, 0x00, 0x00, 0x00, 0x00, 0x00, 0x00, 0x01, 0x80,
    0x0c, 0x00, 0x00, 0x00, 0x00, 0x00, 0x00, 0x00, 0xc0,
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    0x03, 0xff, 0xff, 0xff, 0xff, 0xff, 0xff, 0xff, 0x00

};
void setup()
{
  Serial.begin(9600);
  display.begin(SSD1306_SWITCHCAPVCC, 0x3C);
  display.clearDisplay();
  //display.drawBitmap(29, 10, MusotokuLogo, 70, 48, WHITE);
  //display.display();
  // delay(1000);
  // display.clearDisplay();
  //display.setTextSize(4);
  //display.setTextColor(WHITE);
  // display.setCursor(0, 0);
  // display.print("10.5");
  //display.setCursor(-4, 0);
  // display.print(105);
  //display.display();

  // for (int i = 0; i < 160; i++)
  // {
  //   /* code */
  //   ShowDisplayValue(i);
  //   delay(200);
  // }
     ShowDisplayValue(105);
}

void loop()
{
  // put your main code here, to run repeatedly:
  for (int i = 1; i < MAX_LEDS; i++)
  {
    /* code */
    PowerBar(i);
    delay(10);
  }
  for (int i = MAX_LEDS; i > 0; i--)
  {
    PowerBar(i);
    /* code */
    delay(10);
  }
  // display.clearDisplay();
  // display.display();
}
void ShowDisplayValue(int value)
{
  int intPart;
  int decPart;
  int fracPart;
  int cursor;

  // Config the text
  display.setTextSize(4);
  display.setTextColor(WHITE);

  display.fillRect(0, 0, X_SIZE, 28, BLACK); // clears the screen and buffer
  intPart = value / 10;
  decPart = intPart / 10;
  fracPart = value - 10 * intPart;

  if (value >= 100)
  {
    display.setCursor(-4, 0);
    display.print(intPart);
  }
  else
  {
    display.setCursor(15, 0);
    display.print(intPart);
  }
  //fracPart = value - 100;
  display.fillRect(38, 25, 3, 3, WHITE);
  //display.fillCircle(38, 24, 1, WHITE); // Decimal point 2
  cursor = 44; //
  display.setCursor(cursor, 0);
  display.print(fracPart);
  display.display();
}
void PowerBar(int16_t leds)
{

  int xsize_rect_powerbar = X_SIZE;
  int ysize_rect_powerbar = 18;

  int cursor_x = 0;
  int cursor_y = 29;

  //display.fillRect(0, 30, X_SIZE, Y_SiZE, BLACK);
  leds = constrain(leds, 0, 40);

  if (leds == 0)
  {
    display.fillRect(0, 29, X_SIZE, Y_SiZE, BLACK);
    display.display();
  }
  else
  {
    for (int16_t i = 0; i <= leds; i++)
    {
      display.fillRect(cursor_x, cursor_y, 2, 7, WHITE);
      cursor_x += 4;
    }
    display.fillRect(cursor_x, 29, X_SIZE, ysize_rect_powerbar, BLACK);
  }
  display.display();
}